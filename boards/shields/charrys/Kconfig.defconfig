## boards/shields/charrys/Kconfig.defconfig
```kconfig
if SHIELD_CHARRYS_RIGHT

config ZMK_KEYBOARD_NAME
	default "CHARRYS"

config ZMK_SPLIT_BLE_ROLE_CENTRAL
	default y

endif

if SHIELD_CHARRYS_LEFT || SHIELD_CHARRYS_RIGHT

config ZMK_SPLIT
	default y

endif
```

## boards/shields/charrys/Kconfig.shield
```kconfig
config SHIELD_CHARRYS_LEFT
    def_bool $(shields_list_contains,charrys_left)

config SHIELD_CHARRYS_RIGHT
    def_bool $(shields_list_contains,charrys_right)
```
